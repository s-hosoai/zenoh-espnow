## examples/espnow_node/main/Kconfig.projbuild
```kconfig
menu "ESP-NOW Node"

    config ESPNOW_CHANNEL
        int "Wi-Fi channel"
        default 1
        range 1 13
        help
            All nodes in the same ESP-NOW network must use the same channel.
            Choose a channel that is not heavily occupied by Wi-Fi APs nearby.

    config ZENOH_KEY_PREFIX
        string "Zenoh key expression prefix"
        default "sensor"
        help
            Published key: <prefix>/<MAC>/data
            Subscribed key: <prefix>/**

endmenu
```

## examples/gateway/main/Kconfig.projbuild
```kconfig
menu "Gateway"

    config WIFI_SSID
        string "Wi-Fi SSID (home AP)"
        default "myssid"
        help
            SSID of the home Wi-Fi AP. The gateway connects as a STA.
            ESP-NOW nodes must use the same channel as this AP.

    config WIFI_PASSWORD
        string "Wi-Fi Password"
        default "mypassword"

    config ZENOHD_LOCATOR
        string "zenohd locator"
        default "tcp/192.168.0.100:7447"
        help
            TCP endpoint of the zenohd Router running on PC/SBC.

    config FWD_ESPNOW_TO_WIFI_KEY
        string "Key forwarded ESP-NOW → Wi-Fi"
        default "sensor/**"
        help
            Zenoh key expression subscribed on session_a (ESP-NOW side).
            Matching samples are republished on session_b (Wi-Fi side).

    config FWD_WIFI_TO_ESPNOW_KEY
        string "Key forwarded Wi-Fi → ESP-NOW"
        default "cmd/**"
        help
            Zenoh key expression subscribed on session_b (Wi-Fi side).
            Matching samples are republished on session_a (ESP-NOW side).

endmenu
```

## examples/zenoh_pubsub/Kconfig.projbuild
```kconfig
menu "Zenoh PubSub Example"

    config WIFI_SSID
        string "Wi-Fi SSID"
        default "myssid"
        help
            SSID of the Wi-Fi AP to connect.

    config WIFI_PASSWORD
        string "Wi-Fi Password"
        default "mypassword"
        help
            Password for the Wi-Fi AP.

    config ZENOH_MODE
        int "Zenoh mode (0=client 1=peer)"
        default 0
        range 0 1
        help
            0: client mode — connect to a zenohd router via LOCATOR.
            1: peer mode  — UDP multicast scouting, no router needed.

    config ZENOH_LOCATOR
        string "Zenoh locator (client mode)"
        default "tcp/192.168.1.100:7447"
        depends on ZENOH_MODE = 0
        help
            TCP endpoint of the zenohd router (used in client mode only).

endmenu
```
